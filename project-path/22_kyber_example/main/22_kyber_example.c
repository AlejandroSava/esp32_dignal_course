#include <stdio.h>
#include <string.h>
#include "freertos/FreeRTOS.h"
#include "freertos/task.h"
#include "indcpa.h"
#include "kem.h"
#include "taskpriorities.h"


void print_hex(const char *label, const uint8_t *data, size_t len) {
    printf("%s (%zu bytes):\n", label, len);
    for (size_t i = 0; i < len; i++) {
        printf("0x%02X, ", data[i]);      // two hex digits
        if ((i + 1) % 16 == 0) printf("\n");  // newline every 16 bytes
    }
    printf("\n");
}

void clear_parameters(const char *label, uint8_t *buf, size_t len){
    printf("Cleaning the next parameter %s\n", label);
    memset(buf, 0, len);
}


void copy_pk(uint8_t *buf, size_t len){
    uint8_t pk_temp[CRYPTO_PUBLICKEYBYTES] = {
        0x80,  0xC2,  0x94,  0xED,  0x94,  0x30,  0x7E,  0x09,  0x73,  0xE6,  0xCA,  0xB5,  0x77,  0x72,  0x82,  0x93, 
        0x54,  0x22,  0x81,  0xFA,  0x15,  0x03,  0x7C,  0x58,  0x2A,  0x82,  0x12,  0x5E,  0x91,  0xB7,  0x83,  0x45, 
        0xBC,  0x82,  0x40,  0x6E,  0xEE,  0x95,  0x95,  0xA0,  0x74,  0x1A,  0xA2,  0x56,  0x09,  0xC7,  0x59,  0xA3, 
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        0x8B,  0x5C,  0x90,  0x3A,  0x17,  0x27,  0x94,  0x33,  0x22,  0x18,  0xEA,  0x73,  0x56,  0xBE,  0xFB,  0x24
    };
      for(size_t i=0; i<len; i++)
          buf[i] = pk_temp[i];
}   


void test_kyber_kem(void *pvParameters) {
    configASSERT( ( ( uint32_t ) pvParameters ) == 1 );

    while(1)
    {
        uint8_t pk[CRYPTO_PUBLICKEYBYTES];
        uint8_t sk[CRYPTO_SECRETKEYBYTES];
        uint8_t ct[CRYPTO_CIPHERTEXTBYTES];
        uint8_t key_a[CRYPTO_BYTES];
        uint8_t key_b[CRYPTO_BYTES];

        
        clear_parameters("Public Key (pk)", pk, CRYPTO_PUBLICKEYBYTES);
        clear_parameters("Secret Key (sk)", sk, CRYPTO_SECRETKEYBYTES);
        clear_parameters("Ciphertext (ct)", ct, CRYPTO_CIPHERTEXTBYTES);
        clear_parameters("Shared Key A", key_a, CRYPTO_BYTES);
        clear_parameters("Shared Key B", key_b, CRYPTO_BYTES);

        //Alice generates a public key
        //crypto_kem_keypair(pk, sk);
 

        //Bob derives a secret key and creates a response
        printf("------ DUMPING THE FILE--------\n");
        copy_pk(pk, CRYPTO_PUBLICKEYBYTES);
        printf("2 -------- CRYPTO_KEM_ENC ENCRYPTION ----------- \n");
        crypto_kem_enc(ct, key_b, pk);


        //Alice uses Bobs response to get her shared key
        //crypto_kem_dec(key_a, ct, sk);




        // print parameters: 


        // PRINT CURRENT STATUS
        print_hex("Public Key (pk)", pk, CRYPTO_PUBLICKEYBYTES);
        print_hex("Secret Key (sk)", sk, CRYPTO_SECRETKEYBYTES);
        print_hex("Ciphertext (ct)", ct, CRYPTO_CIPHERTEXTBYTES);
        print_hex("Shared Key A", key_a, CRYPTO_BYTES);
        print_hex("Shared Key B", key_b, CRYPTO_BYTES);

        //Wait 5 seconds
        // fflush(stdout);
        // vTaskDelay(pdMS_TO_TICKS(5000));
        if(memcmp(key_a, key_b, CRYPTO_BYTES)) {
            printf("ERROR keys\n");
        }

        vTaskDelete(NULL);
    }
}

void app_main(void)
{
    BaseType_t xReturned;
    TaskHandle_t xHandle = NULL;

    /* Create the task, storing the handle. */
    xReturned = xTaskCreatePinnedToCore(
                    test_kyber_kem,       /* Function that implements the task. */
                    "NAME",          /* Text name for the task. */
                    20000,      /* Stack size in words, not bytes. */
                    ( void * ) 1,    /* Parameter passed into the task. */
                    MAIN_TASK_PRIORITY, /* Priority at which the task is created. */
                    &xHandle, /* Used to pass out the created task's handle. */
                    (BaseType_t) 0); /* Core ID */     

    if( xReturned == pdPASS )
    {
        /* The task was created.  Use the task's handle to delete the task. */
        //vTaskDelete( xHandle );
    }

    return;
}
